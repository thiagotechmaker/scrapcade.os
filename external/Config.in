## external/package/libretro-easyrpg/Config.in
```kconfig
config BR2_PACKAGE_LIBRETRO_EASYRPG
	bool "libretro-easyrpg"
	select BR2_PACKAGE_LIBLCF
	select BR2_PACKAGE_FMT
	select BR2_PACKAGE_PIXMAN
	select BR2_PACKAGE_SPEEXDSP
	select BR2_PACKAGE_MPG123
	select BR2_PACKAGE_LIBSNDFILE
	select BR2_PACKAGE_LIBVORBIS
	select BR2_PACKAGE_OPUSFILE
	select BR2_PACKAGE_LIBPNG
	select BR2_PACKAGE_ZLIB
	help
	  Nucleo libretro: EasyRPG Player (jogos feitos no RPG Maker 2000/2003).
```

## external/package/libretro-fbneo/Config.in
```kconfig
config BR2_PACKAGE_LIBRETRO_FBNEO
	bool "libretro-fbneo"
	depends on BR2_INSTALL_LIBSTDCPP
	help
	  Nucleo libretro FBNeo para o RetroArch.
```

## external/package/libretro-fceumm/Config.in
```kconfig
config BR2_PACKAGE_LIBRETRO_FCEUMM
	bool "libretro-fceumm"
	help
	  Nucleo libretro fceumm (leve, para o ScrapCade OS de 32 bits).
```

## external/package/libretro-flycast/Config.in
```kconfig
config BR2_PACKAGE_LIBRETRO_FLYCAST
	bool "libretro-flycast"
	depends on BR2_INSTALL_LIBSTDCPP
	help
	  Nucleo libretro Flycast (Dreamcast, NAOMI, Atomiswave).
```
