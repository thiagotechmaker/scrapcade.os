## external/Config.in
```kconfig
source "$BR2_EXTERNAL_TOS_PATH/package/scrapcade/Config.in"
source "$BR2_EXTERNAL_TOS_PATH/package/retroarch/Config.in"
source "$BR2_EXTERNAL_TOS_PATH/package/libretro-mesen/Config.in"
source "$BR2_EXTERNAL_TOS_PATH/package/libretro-snes9x/Config.in"
source "$BR2_EXTERNAL_TOS_PATH/package/libretro-genesisplusgx/Config.in"
source "$BR2_EXTERNAL_TOS_PATH/package/libretro-gambatte/Config.in"
source "$BR2_EXTERNAL_TOS_PATH/package/libretro-mgba/Config.in"
source "$BR2_EXTERNAL_TOS_PATH/package/libretro-pcsx/Config.in"
source "$BR2_EXTERNAL_TOS_PATH/package/libretro-mupen64plus/Config.in"
source "$BR2_EXTERNAL_TOS_PATH/package/libretro-fbneo/Config.in"
source "$BR2_EXTERNAL_TOS_PATH/package/libretro-ppsspp/Config.in"
source "$BR2_EXTERNAL_TOS_PATH/package/libretro-melonds/Config.in"
source "$BR2_EXTERNAL_TOS_PATH/package/libretro-beetle-saturn/Config.in"
source "$BR2_EXTERNAL_TOS_PATH/package/libretro-bsnes/Config.in"
source "$BR2_EXTERNAL_TOS_PATH/package/libretro-flycast/Config.in"
source "$BR2_EXTERNAL_TOS_PATH/package/libretro-prboom/Config.in"
source "$BR2_EXTERNAL_TOS_PATH/package/xash3d-fwgs/Config.in"
source "$BR2_EXTERNAL_TOS_PATH/package/hlsdk-portable/Config.in"
source "$BR2_EXTERNAL_TOS_PATH/package/libretro-fceumm/Config.in"
source "$BR2_EXTERNAL_TOS_PATH/package/libretro-dosbox-pure/Config.in"
source "$BR2_EXTERNAL_TOS_PATH/package/libretro-snes9x2010/Config.in"
source "$BR2_EXTERNAL_TOS_PATH/package/libretro-gpsp/Config.in"
source "$BR2_EXTERNAL_TOS_PATH/package/libretro-picodrive/Config.in"
source "$BR2_EXTERNAL_TOS_PATH/package/libretro-beetle-pce-fast/Config.in"
source "$BR2_EXTERNAL_TOS_PATH/package/libretro-stella2014/Config.in"
source "$BR2_EXTERNAL_TOS_PATH/package/libretro-prosystem/Config.in"
source "$BR2_EXTERNAL_TOS_PATH/package/libretro-handy/Config.in"
source "$BR2_EXTERNAL_TOS_PATH/package/libretro-beetle-ngp/Config.in"
source "$BR2_EXTERNAL_TOS_PATH/package/libretro-beetle-wswan/Config.in"
source "$BR2_EXTERNAL_TOS_PATH/package/libretro-beetle-vb/Config.in"
source "$BR2_EXTERNAL_TOS_PATH/package/libretro-mame2003-plus/Config.in"
source "$BR2_EXTERNAL_TOS_PATH/package/libretro-nxengine/Config.in"
source "$BR2_EXTERNAL_TOS_PATH/package/libretro-tyrquake/Config.in"
source "$BR2_EXTERNAL_TOS_PATH/package/libretro-lrps2/Config.in"
source "$BR2_EXTERNAL_TOS_PATH/package/libretro-dolphin/Config.in"
source "$BR2_EXTERNAL_TOS_PATH/package/libretro-citra/Config.in"
source "$BR2_EXTERNAL_TOS_PATH/package/retroarch-glsl-shaders/Config.in"
source "$BR2_EXTERNAL_TOS_PATH/package/syncthing-bin/Config.in"
source "$BR2_EXTERNAL_TOS_PATH/package/libretro-a5200/Config.in"
source "$BR2_EXTERNAL_TOS_PATH/package/libretro-bluemsx/Config.in"
source "$BR2_EXTERNAL_TOS_PATH/package/libretro-freeintv/Config.in"
source "$BR2_EXTERNAL_TOS_PATH/package/libretro-gearcoleco/Config.in"
source "$BR2_EXTERNAL_TOS_PATH/package/libretro-hatari/Config.in"
source "$BR2_EXTERNAL_TOS_PATH/package/libretro-neocd/Config.in"
source "$BR2_EXTERNAL_TOS_PATH/package/libretro-o2em/Config.in"
source "$BR2_EXTERNAL_TOS_PATH/package/libretro-opera/Config.in"
source "$BR2_EXTERNAL_TOS_PATH/package/libretro-puae/Config.in"
source "$BR2_EXTERNAL_TOS_PATH/package/libretro-vecx/Config.in"
source "$BR2_EXTERNAL_TOS_PATH/package/libretro-vice/Config.in"
source "$BR2_EXTERNAL_TOS_PATH/package/libretro-virtualjaguar/Config.in"
source "$BR2_EXTERNAL_TOS_PATH/package/libretro-scummvm/Config.in"
source "$BR2_EXTERNAL_TOS_PATH/package/liblcf/Config.in"
source "$BR2_EXTERNAL_TOS_PATH/package/libretro-easyrpg/Config.in"
source "$BR2_EXTERNAL_TOS_PATH/package/xemu-bin/Config.in"
source "$BR2_EXTERNAL_TOS_PATH/package/rpcs3-bin/Config.in"
source "$BR2_EXTERNAL_TOS_PATH/package/emutos-bin/Config.in"
source "$BR2_EXTERNAL_TOS_PATH/package/fribidi/Config.in"
source "$BR2_EXTERNAL_TOS_PATH/package/libgsf/Config.in"
source "$BR2_EXTERNAL_TOS_PATH/package/goffice/Config.in"
source "$BR2_EXTERNAL_TOS_PATH/package/gnumeric/Config.in"
source "$BR2_EXTERNAL_TOS_PATH/package/l3afpad/Config.in"
```

## external/configs/tos_x86_64_defconfig
```kconfig
BR2_x86_64=y
BR2_PACKAGE_HOST_LINUX_HEADERS_CUSTOM_6_12=y
BR2_GLOBAL_PATCH_DIR="$(BR2_EXTERNAL_TOS_PATH)/board/x86_64/patches"
BR2_DOWNLOAD_FORCE_CHECK_HASHES=y
BR2_ROOTFS_DEVICE_CREATION_DYNAMIC_EUDEV=y
BR2_ROOTFS_POST_BUILD_SCRIPT="$(BR2_EXTERNAL_TOS_PATH)/board/x86_64/post-build.sh"
BR2_ROOTFS_POST_IMAGE_SCRIPT="$(BR2_EXTERNAL_TOS_PATH)/board/x86_64/post-image-efi.sh"
BR2_LINUX_KERNEL=y
BR2_LINUX_KERNEL_CUSTOM_VERSION=y
BR2_LINUX_KERNEL_CUSTOM_VERSION_VALUE="6.12.47"
BR2_LINUX_KERNEL_USE_CUSTOM_CONFIG=y
BR2_LINUX_KERNEL_CUSTOM_CONFIG_FILE="$(BR2_EXTERNAL_TOS_PATH)/board/x86_64/linux.config"
BR2_LINUX_KERNEL_INSTALL_TARGET=y
BR2_LINUX_KERNEL_NEEDS_HOST_OPENSSL=y
BR2_LINUX_KERNEL_NEEDS_HOST_LIBELF=y
BR2_PACKAGE_LINUX_FIRMWARE=y
BR2_PACKAGE_LINUX_FIRMWARE_ATHEROS_9170=y
BR2_PACKAGE_LINUX_FIRMWARE_ATHEROS_9271=y
BR2_PACKAGE_LINUX_FIRMWARE_IWLWIFI_3160=y
BR2_PACKAGE_LINUX_FIRMWARE_IWLWIFI_3168=y
BR2_PACKAGE_LINUX_FIRMWARE_IWLWIFI_5000=y
BR2_PACKAGE_LINUX_FIRMWARE_IWLWIFI_6000G2A=y
BR2_PACKAGE_LINUX_FIRMWARE_IWLWIFI_6000G2B=y
BR2_PACKAGE_LINUX_FIRMWARE_IWLWIFI_7260=y
BR2_PACKAGE_LINUX_FIRMWARE_IWLWIFI_7265D=y
BR2_PACKAGE_LINUX_FIRMWARE_IWLWIFI_8000C=y
BR2_PACKAGE_LINUX_FIRMWARE_IWLWIFI_8265=y
BR2_PACKAGE_LINUX_FIRMWARE_RALINK_RT73=y
BR2_PACKAGE_LINUX_FIRMWARE_RALINK_RT2XX=y
BR2_PACKAGE_LINUX_FIRMWARE_RTL_81XX=y
BR2_PACKAGE_LINUX_FIRMWARE_RTL_87XX=y
BR2_PACKAGE_LINUX_FIRMWARE_RTL_88XX=y
BR2_PACKAGE_LINUX_FIRMWARE_RTL_8169=y
BR2_PACKAGE_ACPID=y
BR2_PACKAGE_CONNMAN=y
BR2_PACKAGE_CONNMAN_WIFI=y
BR2_PACKAGE_CONNMAN_CLIENT=y
BR2_PACKAGE_WIRELESS_REGDB=y
# BR2_TARGET_ROOTFS_TAR is not set
BR2_TARGET_GRUB2=y
BR2_TARGET_GRUB2_X86_64_EFI=y
BR2_PACKAGE_HOST_DOSFSTOOLS=y
BR2_PACKAGE_HOST_GENIMAGE=y
BR2_PACKAGE_HOST_MTOOLS=y
BR2_TOOLCHAIN_EXTERNAL=y
BR2_TOOLCHAIN_EXTERNAL_BOOTLIN=y
BR2_TARGET_GENERIC_HOSTNAME="t-os"
BR2_TARGET_GENERIC_ISSUE="T-OS 2026.11"
BR2_ROOTFS_OVERLAY="$(BR2_EXTERNAL_TOS_PATH)/board/common/rootfs-overlay"
BR2_CCACHE=y
BR2_TOOLCHAIN_EXTERNAL_BOOTLIN_X86_64_GLIBC_STABLE=y
BR2_TARGET_GENERIC_GETTY_PORT="tty2"
BR2_PACKAGE_SCRAPCADE=y
BR2_PACKAGE_DEJAVU=y
# BR2_PACKAGE_DEJAVU_MONO is not set
# BR2_PACKAGE_DEJAVU_SERIF is not set
# BR2_PACKAGE_DEJAVU_SANS_CONDENSED is not set
# BR2_PACKAGE_DEJAVU_SERIF_CONDENSED is not set
# --- graficos T-OS ---
BR2_LINUX_KERNEL_CONFIG_FRAGMENT_FILES="$(BR2_EXTERNAL_TOS_PATH)/board/x86_64/linux-tos.fragment"
BR2_PACKAGE_LINUX_FIRMWARE_AMDGPU=y
BR2_PACKAGE_LINUX_FIRMWARE_RADEON=y
BR2_PACKAGE_LINUX_FIRMWARE_I915=y
BR2_PACKAGE_MESA3D=y
BR2_PACKAGE_MESA3D_LLVM=y
BR2_PACKAGE_MESA3D_GALLIUM_DRIVER_CROCUS=y
BR2_PACKAGE_MESA3D_GALLIUM_DRIVER_I915=y
BR2_PACKAGE_MESA3D_GALLIUM_DRIVER_IRIS=y
BR2_PACKAGE_MESA3D_GALLIUM_DRIVER_LLVMPIPE=y
BR2_PACKAGE_MESA3D_GALLIUM_DRIVER_NOUVEAU=y
BR2_PACKAGE_MESA3D_GALLIUM_DRIVER_R300=y
BR2_PACKAGE_MESA3D_GALLIUM_DRIVER_R600=y
BR2_PACKAGE_MESA3D_GALLIUM_DRIVER_RADEONSI=y
BR2_PACKAGE_MESA3D_GALLIUM_DRIVER_VIRGL=y
BR2_PACKAGE_MESA3D_GBM=y
BR2_PACKAGE_MESA3D_OPENGL_EGL=y
BR2_PACKAGE_MESA3D_OPENGL_ES=y
BR2_PACKAGE_SDL2=y
BR2_PACKAGE_SDL2_KMSDRM=y
BR2_PACKAGE_SDL2_OPENGLES=y
BR2_PACKAGE_SDL2_IMAGE=y
BR2_PACKAGE_SDL2_TTF=y
BR2_PACKAGE_LIBCURL=y
BR2_PACKAGE_CA_CERTIFICATES=y
BR2_PACKAGE_LIBPNG=y
BR2_PACKAGE_JPEG=y
BR2_PACKAGE_ZLIB=y
BR2_PACKAGE_LIBZIP=y
BR2_PACKAGE_OPENSSL=y
BR2_PACKAGE_LIBOPENSSL=y
BR2_PACKAGE_LIBCURL_OPENSSL=y
BR2_PACKAGE_HOST_XORRISO=y
BR2_TARGET_GRUB2_BUILTIN_MODULES_EFI="boot linux ext2 fat squash4 part_msdos part_gpt normal efi_gop iso9660 search search_fs_file all_video"
# --- modo desktop (Fluxbox): so X, Fluxbox, terminal e fundo de tela
BR2_PACKAGE_XORG7=y
BR2_PACKAGE_XSERVER_XORG_SERVER=y
BR2_PACKAGE_XSERVER_XORG_SERVER_MODULAR=y
BR2_PACKAGE_XDRIVER_XF86_INPUT_LIBINPUT=y
BR2_PACKAGE_XAPP_XINIT=y
BR2_PACKAGE_XAPP_XRANDR=y
BR2_PACKAGE_MESA3D_OPENGL_GLX=y
BR2_PACKAGE_FLUXBOX=y
BR2_PACKAGE_XTERM=y
BR2_PACKAGE_FEH=y
BR2_PACKAGE_DEJAVU_MONO=y
# --- particoes: sistema somente leitura (squashfs) e dados do usuario (exFAT)
BR2_TARGET_ROOTFS_SQUASHFS=y
BR2_TARGET_ROOTFS_SQUASHFS4_ZSTD=y
BR2_PACKAGE_UTIL_LINUX=y
BR2_PACKAGE_UTIL_LINUX_BINARIES=y
BR2_PACKAGE_UTIL_LINUX_PARTX=y
BR2_PACKAGE_EXFATPROGS=y
BR2_PACKAGE_IMLIB2_JPEG=y
BR2_PACKAGE_IMLIB2_PNG=y
# --- emuladores: RetroArch (KMS, sem X) e nucleos libretro; som ALSA
BR2_PACKAGE_ALSA_LIB=y
BR2_PACKAGE_ALSA_UTILS=y
BR2_PACKAGE_ALSA_UTILS_AMIXER=y
BR2_PACKAGE_FREETYPE=y
BR2_PACKAGE_RETROARCH=y
BR2_PACKAGE_LIBRETRO_MESEN=y
BR2_PACKAGE_LIBRETRO_SNES9X=y
BR2_PACKAGE_LIBRETRO_GENESISPLUSGX=y
BR2_PACKAGE_LIBRETRO_GAMBATTE=y
BR2_PACKAGE_LIBRETRO_MGBA=y
BR2_PACKAGE_LIBRETRO_PCSX=y
BR2_PACKAGE_LIBRETRO_MUPEN64PLUS=y
BR2_PACKAGE_LIBRETRO_FBNEO=y
# --- pacote leve de desktop e instalador
BR2_PACKAGE_LIBGTK3=y
BR2_PACKAGE_LIBGTK3_X11=y
BR2_PACKAGE_NETSURF=y
BR2_PACKAGE_NETSURF_GTK3=y
BR2_PACKAGE_PCMANFM=y
BR2_PACKAGE_MPV=y
BR2_PACKAGE_NANO=y
BR2_PACKAGE_MUPDF=y
BR2_PACKAGE_ALSA_UTILS_ALSAMIXER=y
BR2_PACKAGE_DOSFSTOOLS=y
BR2_PACKAGE_DOSFSTOOLS_MKFS_FAT=y
BR2_PACKAGE_EFIBOOTMGR=y
BR2_TARGET_GRUB2_I386_PC=y
BR2_TARGET_GRUB2_BOOT_PARTITION="hd0,msdos1"
BR2_TARGET_GRUB2_BUILTIN_MODULES_PC="boot linux ext2 fat part_msdos part_gpt normal biosdisk iso9660 search search_fs_file configfile"
BR2_TARGET_SYSLINUX=y
BR2_TARGET_SYSLINUX_ISOLINUX=y
BR2_TARGET_SYSLINUX_MBR=y
BR2_TARGET_SYSLINUX_C32="vesamenu.c32 libcom32.c32 libutil.c32 chain.c32"
BR2_PACKAGE_MEMTEST86=y
# --- firmwares de Wi-Fi e de placas de rede (redistribuiveis)
BR2_PACKAGE_LINUX_FIRMWARE_BRCM_BCM43XX=y
BR2_PACKAGE_LINUX_FIRMWARE_BRCM_BCM43XXX=y
BR2_PACKAGE_LINUX_FIRMWARE_IWLWIFI_100=y
BR2_PACKAGE_LINUX_FIRMWARE_IWLWIFI_105=y
BR2_PACKAGE_LINUX_FIRMWARE_IWLWIFI_135=y
BR2_PACKAGE_LINUX_FIRMWARE_IWLWIFI_1000=y
BR2_PACKAGE_LINUX_FIRMWARE_IWLWIFI_2000=y
BR2_PACKAGE_LINUX_FIRMWARE_IWLWIFI_2030=y
BR2_PACKAGE_LINUX_FIRMWARE_IWLWIFI_3945=y
BR2_PACKAGE_LINUX_FIRMWARE_IWLWIFI_4965=y
BR2_PACKAGE_LINUX_FIRMWARE_IWLWIFI_9XXX=y
BR2_PACKAGE_LINUX_FIRMWARE_IWLWIFI_22000=y
BR2_PACKAGE_LINUX_FIRMWARE_IWLWIFI_QUZ=y
BR2_PACKAGE_LINUX_FIRMWARE_ATHEROS_10K_QCA9377=y
BR2_PACKAGE_LINUX_FIRMWARE_ATHEROS_10K_QCA998X=y
BR2_PACKAGE_LINUX_FIRMWARE_MEDIATEK_MT7601U=y
BR2_PACKAGE_LINUX_FIRMWARE_MEDIATEK_MT7610E=y
BR2_PACKAGE_LINUX_FIRMWARE_MEDIATEK_MT76X2E=y
BR2_PACKAGE_LINUX_FIRMWARE_MEDIATEK_MT7921=y
BR2_PACKAGE_LINUX_FIRMWARE_MEDIATEK_MT7922=y
BR2_PACKAGE_LINUX_FIRMWARE_RTL_RTW88=y
BR2_PACKAGE_LINUX_FIRMWARE_RTL_RTW89=y
BR2_PACKAGE_LINUX_FIRMWARE_RTL_815X=y
BR2_PACKAGE_LINUX_FIRMWARE_BNX2=y
BR2_PACKAGE_ADWAITA_ICON_THEME=y
BR2_PACKAGE_HICOLOR_ICON_THEME=y
# --- microcodigo da CPU Intel (correcoes de estabilidade do fabricante)
BR2_PACKAGE_INTEL_MICROCODE=y
# --- fase 1: Bluetooth, Vulkan, Samba, SSH, relogio e nucleos novos
BR2_PACKAGE_BLUEZ5_UTILS=y
BR2_PACKAGE_BLUEZ5_UTILS_CLIENT=y
BR2_PACKAGE_BLUEZ5_UTILS_PLUGINS_HID=y
BR2_PACKAGE_LINUX_FIRMWARE_IBT=y
BR2_PACKAGE_LINUX_FIRMWARE_RTL_87XX_BT=y
BR2_PACKAGE_LINUX_FIRMWARE_RTL_88XX_BT=y
BR2_PACKAGE_LINUX_FIRMWARE_MEDIATEK_MT7921_BT=y
BR2_PACKAGE_LINUX_FIRMWARE_MEDIATEK_MT7922_BT=y
BR2_PACKAGE_LINUX_FIRMWARE_QUALCOMM_6174A_BT=y
BR2_PACKAGE_LINUX_FIRMWARE_QUALCOMM_9377_BT=y
BR2_PACKAGE_MESA3D_VULKAN_DRIVER_INTEL=y
BR2_PACKAGE_MESA3D_VULKAN_DRIVER_SWRAST=y
BR2_PACKAGE_VULKAN_LOADER=y
BR2_PACKAGE_VULKAN_HEADERS=y
BR2_PACKAGE_SAMBA4=y
BR2_PACKAGE_DROPBEAR=y
BR2_PACKAGE_CHRONY=y
BR2_TARGET_TZ_INFO=y
BR2_TARGET_LOCALTIME="America/Sao_Paulo"
BR2_PACKAGE_LIBRETRO_PPSSPP=y
BR2_PACKAGE_LIBRETRO_MELONDS=y
BR2_PACKAGE_LIBRETRO_BEETLE_SATURN=y
BR2_PACKAGE_LIBRETRO_BSNES=y
BR2_PACKAGE_HOST_PYTHON3_SSL=y
```

## external/package/emutos-bin/Config.in
```kconfig
config BR2_PACKAGE_EMUTOS_BIN
	bool "emutos-bin"
	help
	  EmuTOS: sistema livre (GPL) que substitui o TOS da Atari no emulador do Atari ST.
```

## external/package/fribidi/Config.in
```kconfig
config BR2_PACKAGE_FRIBIDI
	bool "fribidi"
	help
	  Algoritmo bidirecional do Unicode (texto da direita para a esquerda).
```

## external/package/gnumeric/Config.in
```kconfig
config BR2_PACKAGE_GNUMERIC
	bool "gnumeric"
	depends on BR2_PACKAGE_LIBGTK3
	select BR2_PACKAGE_GOFFICE
	select BR2_PACKAGE_FRIBIDI
	help
	  Planilha leve (abre .xls, .xlsx, .ods e .csv).
```

## external/package/goffice/Config.in
```kconfig
config BR2_PACKAGE_GOFFICE
	bool "goffice"
	depends on BR2_PACKAGE_LIBGTK3
	select BR2_PACKAGE_LIBGSF
	select BR2_PACKAGE_LIBXSLT
	select BR2_PACKAGE_CAIRO
	select BR2_PACKAGE_PANGO
	help
	  Graficos e formatos de escritorio do Gnumeric.
```

## external/package/hlsdk-portable/Config.in
```kconfig
config BR2_PACKAGE_HLSDK_PORTABLE
	bool "hlsdk-portable"
	depends on BR2_INSTALL_LIBSTDCPP
	depends on BR2_PACKAGE_XASH3D_FWGS
	help
	  Bibliotecas do jogo Half-Life (hlsdk-portable) para o Xash3D FWGS.
	  Licenca do Half-Life 1 SDK: distribuicao so gratuita, com o LICENSE junto.
```

## external/package/l3afpad/Config.in
```kconfig
config BR2_PACKAGE_L3AFPAD
	bool "l3afpad"
	depends on BR2_PACKAGE_LIBGTK3
	help
	  Editor de texto pequeno (GTK3).
```

## external/package/libgsf/Config.in
```kconfig
config BR2_PACKAGE_LIBGSF
	bool "libgsf"
	select BR2_PACKAGE_LIBGLIB2
	select BR2_PACKAGE_LIBXML2
	select BR2_PACKAGE_ZLIB
	help
	  Biblioteca de arquivos estruturados do GNOME (base do Gnumeric).
```

## external/package/liblcf/Config.in
```kconfig
config BR2_PACKAGE_LIBLCF
	bool "liblcf"
	select BR2_PACKAGE_EXPAT
	select BR2_PACKAGE_INIH
	help
	  Biblioteca do EasyRPG que le os projetos do RPG Maker 2000/2003.
```

## external/package/libretro-a5200/Config.in
```kconfig
config BR2_PACKAGE_LIBRETRO_A5200
	bool "libretro-a5200"
	help
	  Nucleo libretro: Atari 5200.
```

## external/package/libretro-beetle-ngp/Config.in
```kconfig
config BR2_PACKAGE_LIBRETRO_BEETLE_NGP
	bool "libretro-beetle-ngp"
	help
	  Nucleo libretro: Neo Geo Pocket e Pocket Color.
```

## external/package/libretro-beetle-pce-fast/Config.in
```kconfig
config BR2_PACKAGE_LIBRETRO_BEETLE_PCE_FAST
	bool "libretro-beetle-pce-fast"
	help
	  Nucleo libretro: PC Engine / TurboGrafx-16 e PC Engine CD.
```

## external/package/libretro-beetle-saturn/Config.in
```kconfig
config BR2_PACKAGE_LIBRETRO_BEETLE_SATURN
	bool "libretro-beetle-saturn"
	depends on BR2_INSTALL_LIBSTDCPP
	help
	  Nucleo libretro libretro-beetle-saturn para o RetroArch.
```

## external/package/libretro-beetle-vb/Config.in
```kconfig
config BR2_PACKAGE_LIBRETRO_BEETLE_VB
	bool "libretro-beetle-vb"
	help
	  Nucleo libretro: Virtual Boy.
```

## external/package/libretro-beetle-wswan/Config.in
```kconfig
config BR2_PACKAGE_LIBRETRO_BEETLE_WSWAN
	bool "libretro-beetle-wswan"
	help
	  Nucleo libretro: WonderSwan e WonderSwan Color.
```

## external/package/libretro-bluemsx/Config.in
```kconfig
config BR2_PACKAGE_LIBRETRO_BLUEMSX
	bool "libretro-bluemsx"
	help
	  Nucleo libretro: MSX, MSX2 e SVI.
```

## external/package/libretro-bsnes/Config.in
```kconfig
config BR2_PACKAGE_LIBRETRO_BSNES
	bool "libretro-bsnes"
	depends on BR2_INSTALL_LIBSTDCPP
	help
	  Nucleo libretro libretro-bsnes para o RetroArch.
```

## external/package/libretro-citra/Config.in
```kconfig
config BR2_PACKAGE_LIBRETRO_CITRA
	bool "libretro-citra"
	depends on BR2_x86_64
	help
	  Nucleo libretro: Nintendo 3DS (Citra). So na versao de 64 bits.
```

## external/package/libretro-dolphin/Config.in
```kconfig
config BR2_PACKAGE_LIBRETRO_DOLPHIN
	bool "libretro-dolphin"
	depends on BR2_x86_64
	help
	  Nucleo libretro: GameCube e Wii (Dolphin). So na versao de 64 bits.
```

## external/package/libretro-dosbox-pure/Config.in
```kconfig
config BR2_PACKAGE_LIBRETRO_DOSBOX_PURE
	bool "libretro-dosbox-pure"
	depends on BR2_INSTALL_LIBSTDCPP
	depends on BR2_TOOLCHAIN_HAS_THREADS
	help
	  Nucleo libretro DOSBox Pure: jogos de PC antigos (DOS), direto do .zip, com teclado na tela e controle.
```
