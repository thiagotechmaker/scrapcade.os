## external/package/libretro-freeintv/Config.in
```kconfig
config BR2_PACKAGE_LIBRETRO_FREEINTV
	bool "libretro-freeintv"
	help
	  Nucleo libretro: Intellivision.
```

## external/package/libretro-gambatte/Config.in
```kconfig
config BR2_PACKAGE_LIBRETRO_GAMBATTE
	bool "libretro-gambatte"
	depends on BR2_INSTALL_LIBSTDCPP
	help
	  Nucleo libretro gambatte-libretro para o RetroArch.
```

## external/package/libretro-gearcoleco/Config.in
```kconfig
config BR2_PACKAGE_LIBRETRO_GEARCOLECO
	bool "libretro-gearcoleco"
	help
	  Nucleo libretro: ColecoVision.
```

## external/package/libretro-genesisplusgx/Config.in
```kconfig
config BR2_PACKAGE_LIBRETRO_GENESISPLUSGX
	bool "libretro-genesisplusgx"
	depends on BR2_INSTALL_LIBSTDCPP
	help
	  Nucleo libretro Genesis-Plus-GX para o RetroArch.
```

## external/package/libretro-gpsp/Config.in
```kconfig
config BR2_PACKAGE_LIBRETRO_GPSP
	bool "libretro-gpsp"
	help
	  Nucleo libretro gpsp (leve, para o ScrapCade OS de 32 bits).
```

## external/package/libretro-handy/Config.in
```kconfig
config BR2_PACKAGE_LIBRETRO_HANDY
	bool "libretro-handy"
	help
	  Nucleo libretro: Atari Lynx.
```

## external/package/libretro-hatari/Config.in
```kconfig
config BR2_PACKAGE_LIBRETRO_HATARI
	bool "libretro-hatari"
	help
	  Nucleo libretro: Atari ST.
```

## external/package/libretro-lrps2/Config.in
```kconfig
config BR2_PACKAGE_LIBRETRO_LRPS2
	bool "libretro-lrps2"
	depends on BR2_x86_64
	help
	  Nucleo libretro: PlayStation 2 (LRPS2). So na versao de 64 bits.
```

## external/package/libretro-mame2003-plus/Config.in
```kconfig
config BR2_PACKAGE_LIBRETRO_MAME2003_PLUS
	bool "libretro-mame2003-plus"
	help
	  Nucleo libretro: MAME 2003-Plus (fliperama).
```

## external/package/libretro-melonds/Config.in
```kconfig
config BR2_PACKAGE_LIBRETRO_MELONDS
	bool "libretro-melonds"
	depends on BR2_INSTALL_LIBSTDCPP
	help
	  Nucleo libretro libretro-melonds para o RetroArch.
```

## external/package/libretro-mesen/Config.in
```kconfig
config BR2_PACKAGE_LIBRETRO_MESEN
	bool "libretro-mesen"
	depends on BR2_INSTALL_LIBSTDCPP
	help
	  Nucleo libretro Mesen para o RetroArch.
```

## external/package/libretro-mupen64plus/Config.in
```kconfig
config BR2_PACKAGE_LIBRETRO_MUPEN64PLUS
	bool "libretro-mupen64plus"
	depends on BR2_INSTALL_LIBSTDCPP
	help
	  Nucleo libretro mupen64plus-libretro-nx para o RetroArch.
```

## external/package/libretro-neocd/Config.in
```kconfig
config BR2_PACKAGE_LIBRETRO_NEOCD
	bool "libretro-neocd"
	help
	  Nucleo libretro: Neo Geo CD.
```

## external/package/libretro-nxengine/Config.in
```kconfig
config BR2_PACKAGE_LIBRETRO_NXENGINE
	bool "libretro-nxengine"
	help
	  Nucleo libretro: NXEngine (Cave Story).
```

## external/package/libretro-o2em/Config.in
```kconfig
config BR2_PACKAGE_LIBRETRO_O2EM
	bool "libretro-o2em"
	help
	  Nucleo libretro: Odyssey2 / Videopac.
```

## external/package/libretro-opera/Config.in
```kconfig
config BR2_PACKAGE_LIBRETRO_OPERA
	bool "libretro-opera"
	help
	  Nucleo libretro: 3DO.
```

## external/package/libretro-pcsx/Config.in
```kconfig
config BR2_PACKAGE_LIBRETRO_PCSX
	bool "libretro-pcsx"
	depends on BR2_INSTALL_LIBSTDCPP
	help
	  Nucleo libretro pcsx_rearmed para o RetroArch.
```

## external/package/libretro-picodrive/Config.in
```kconfig
config BR2_PACKAGE_LIBRETRO_PICODRIVE
	bool "libretro-picodrive"
	help
	  Nucleo libretro picodrive: o 32X nas duas versoes e o Mega Drive leve no ScrapCade OS de 32 bits.
```

## external/package/libretro-ppsspp/Config.in
```kconfig
config BR2_PACKAGE_LIBRETRO_PPSSPP
	bool "libretro-ppsspp"
	depends on BR2_INSTALL_LIBSTDCPP
	help
	  Nucleo libretro libretro-ppsspp para o RetroArch.
```

## external/package/libretro-prboom/Config.in
```kconfig
config BR2_PACKAGE_LIBRETRO_PRBOOM
	bool "libretro-prboom"
	help
	  Nucleo libretro PrBoom (Doom e jogos .wad, como o Freedoom) para o RetroArch.
```

## external/package/libretro-prosystem/Config.in
```kconfig
config BR2_PACKAGE_LIBRETRO_PROSYSTEM
	bool "libretro-prosystem"
	help
	  Nucleo libretro: Atari 7800.
```

## external/package/libretro-puae/Config.in
```kconfig
config BR2_PACKAGE_LIBRETRO_PUAE
	bool "libretro-puae"
	help
	  Nucleo libretro: Amiga.
```

## external/package/libretro-scummvm/Config.in
```kconfig
config BR2_PACKAGE_LIBRETRO_SCUMMVM
	bool "libretro-scummvm"
	select BR2_PACKAGE_ZLIB
	select BR2_PACKAGE_FREETYPE
	select BR2_PACKAGE_FLAC
	select BR2_PACKAGE_LIBVORBIS
	select BR2_PACKAGE_FAAD2
	select BR2_PACKAGE_FLUIDSYNTH
	help
	  Nucleo libretro: ScummVM (jogos de aventura da LucasArts, Sierra e outros).
```

## external/package/libretro-snes9x/Config.in
```kconfig
config BR2_PACKAGE_LIBRETRO_SNES9X
	bool "libretro-snes9x"
	depends on BR2_INSTALL_LIBSTDCPP
	help
	  Nucleo libretro snes9x para o RetroArch.
```

## external/package/libretro-snes9x2010/Config.in
```kconfig
config BR2_PACKAGE_LIBRETRO_SNES9X2010
	bool "libretro-snes9x2010"
	help
	  Nucleo libretro snes9x2010 (leve, para o ScrapCade OS de 32 bits).
```
