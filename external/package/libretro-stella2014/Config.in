## external/package/libretro-stella2014/Config.in
```kconfig
config BR2_PACKAGE_LIBRETRO_STELLA2014
	bool "libretro-stella2014"
	help
	  Nucleo libretro: Atari 2600.
```

## external/package/libretro-tyrquake/Config.in
```kconfig
config BR2_PACKAGE_LIBRETRO_TYRQUAKE
	bool "libretro-tyrquake"
	help
	  Nucleo libretro: TyrQuake (Quake).
```

## external/package/libretro-vecx/Config.in
```kconfig
config BR2_PACKAGE_LIBRETRO_VECX
	bool "libretro-vecx"
	help
	  Nucleo libretro: Vectrex.
```

## external/package/libretro-vice/Config.in
```kconfig
config BR2_PACKAGE_LIBRETRO_VICE
	bool "libretro-vice"
	help
	  Nucleo libretro: Commodore 64.
```

## external/package/libretro-virtualjaguar/Config.in
```kconfig
config BR2_PACKAGE_LIBRETRO_VIRTUALJAGUAR
	bool "libretro-virtualjaguar"
	help
	  Nucleo libretro: Atari Jaguar.
```

## external/package/retroarch-glsl-shaders/Config.in
```kconfig
config BR2_PACKAGE_RETROARCH_GLSL_SHADERS
	bool "retroarch-glsl-shaders"
	help
	  Pacote completo de filtros GLSL do RetroArch (escolhidos por console no painel).
```

## external/package/retroarch/Config.in
```kconfig
config BR2_PACKAGE_RETROARCH
	bool "retroarch"
	depends on BR2_INSTALL_LIBSTDCPP
	depends on BR2_TOOLCHAIN_HAS_THREADS
	select BR2_PACKAGE_ZLIB
	select BR2_PACKAGE_ALSA_LIB
	select BR2_PACKAGE_SDL2
	select BR2_PACKAGE_LIBDRM
	select BR2_PACKAGE_MESA3D
	select BR2_PACKAGE_FREETYPE
	select BR2_PACKAGE_EUDEV
	help
	  RetroArch: roda os nucleos libretro (emuladores). No T-OS abre
	  direto pela placa de video (KMS), sem X, com o menu RGUI.
```

## external/package/rpcs3-bin/Config.in
```kconfig
config BR2_PACKAGE_RPCS3_BIN
	bool "rpcs3-bin"
	depends on BR2_x86_64
	help
	  RPCS3: emulador do PlayStation 3 (AppImage oficial, aberta na imagem).
```

## external/package/scrapcade/Config.in
```kconfig
config BR2_PACKAGE_SCRAPCADE
	bool "scrapcade"
	depends on BR2_INSTALL_LIBSTDCPP
	depends on BR2_TOOLCHAIN_HAS_THREADS
	select BR2_PACKAGE_SDL2
	select BR2_PACKAGE_SDL2_TTF
	select BR2_PACKAGE_SDL2_IMAGE
	select BR2_PACKAGE_LIBPNG
	select BR2_PACKAGE_JPEG
	select BR2_PACKAGE_DEJAVU
	select BR2_PACKAGE_ZLIB
	select BR2_PACKAGE_LIBZIP
	select BR2_PACKAGE_LIBCURL
	select BR2_PACKAGE_OPENSSL
	select BR2_PACKAGE_CA_CERTIFICATES
	help
	  ScrapCade: menu de jogos do ScrapCade (modo jogo), em C++ com SDL2.
	  Mesmo visual do ScrapCade do iChroma: dados dos jogos pelo CRC,
	  capas do acervo libretro e organizacao da pasta "Jogos novos".
```

## external/package/syncthing-bin/Config.in
```kconfig
config BR2_PACKAGE_SYNCTHING_BIN
	bool "syncthing-bin"
	help
	  Syncthing: sincroniza os saves entre os aparelhos (binario oficial).
```

## external/package/xash3d-fwgs/Config.in
```kconfig
config BR2_PACKAGE_XASH3D_FWGS
	bool "xash3d-fwgs"
	depends on BR2_INSTALL_LIBSTDCPP
	select BR2_PACKAGE_SDL2
	select BR2_PACKAGE_FREETYPE
	help
	  Motor Xash3D FWGS (GPLv3), compativel com o Half-Life. Os dados do jogo
	  sao do usuario (copia da Steam).
```

## external/package/xemu-bin/Config.in
```kconfig
config BR2_PACKAGE_XEMU_BIN
	bool "xemu-bin"
	depends on BR2_x86_64
	select BR2_PACKAGE_LIBUSB
	help
	  xemu: emulador do Xbox original (AppImage oficial, aberta na imagem).
```
